## boards/shields/LG/Kconfig.defconfig
```kconfig
if SHIELD_LG_LEFT

config ZMK_KEYBOARD_NAME
    default "LG"

config ZMK_SPLIT_ROLE_CENTRAL
    default y

endif

if SHIELD_LG_LEFT || SHIELD_LG_RIGHT
    
config ZMK_SPLIT
    default y

endif
```

## boards/shields/LG/Kconfig.shield
```kconfig
config SHIELD_LG_LEFT
    def_bool $(shields_list_contains,LG_left)

config SHIELD_LG_RIGHT
    def_bool $(shields_list_contains,LG_right)
```
